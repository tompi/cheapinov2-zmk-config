## boards/shields/cheapinov2/Kconfig.defconfig
```kconfig
# Copyright (c) 2022 The ZMK Contributors
# SPDX-License-Identifier: MIT
#
CONFIG_ZMK_SPLIT_BLE_CENTRAL_BATTERY_LEVEL_PROXY = Y
CONFIG_ZMK_SPLIT_BLE_CENTRAL_BATTERY_LEVEL_FETCHING = Y
CONFIG_ZMK_MOUSE=y

if SHIELD_CHEAPINOV2_LEFT

config ZMK_KEYBOARD_NAME
    default "Cheapino v2"
    
config ZMK_SPLIT_ROLE_CENTRAL
    default y

endif

if SHIELD_CHEAPINOV2_LEFT || SHIELD_CHEAPINOV2_RIGHT

config ZMK_SPLIT
    default y

endif
```

## boards/shields/cheapinov2/Kconfig.shield
```kconfig
# Copyright (c) 2022 The ZMK Contributors
# SPDX-License-Identifier: MIT

config SHIELD_CHEAPINOV2_LEFT
    def_bool $(shields_list_contains,cheapinov2_left)

config SHIELD_CHEAPINOV2_RIGHT
    def_bool $(shields_list_contains,cheapinov2_right)
```
